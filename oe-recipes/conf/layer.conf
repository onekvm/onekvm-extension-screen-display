## oe-recipes/conf/layer.conf
```bitbake
BBPATH .= ":${LAYERDIR}"
BBFILES += "${LAYERDIR}/recipes-*/*/*.bb ${LAYERDIR}/recipes-*/*/*.bbappend"
BBFILE_COLLECTIONS += "onekvm-extension-screen-display"
BBFILE_PATTERN_onekvm-extension-screen-display := "^${LAYERDIR}/"
BBFILE_PRIORITY_onekvm-extension-screen-display = "8"
LAYERDEPENDS_onekvm-extension-screen-display = "core onekvm"
LAYERSERIES_COMPAT_onekvm-extension-screen-display = "wrynose"
```
